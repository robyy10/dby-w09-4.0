/*---------------------------------------------------------------------------
 * This file is autogenerated file using huawei LCD parser. Please do not edit it.
 * Update input XML file to add a new entry or update variable in this file
 * Parser location: vendor/huawei/chipset_common/devkit/lcdkit/tools 
 *---------------------------------------------------------------------------*/


#include "dbr_110_a09_10p95_qcom.dtsi"
#include "dbr_190_a09_10p95_qcom.dtsi"
#include "dbr_auo_otm1901a_5p2_1080p_video_default.dtsi"