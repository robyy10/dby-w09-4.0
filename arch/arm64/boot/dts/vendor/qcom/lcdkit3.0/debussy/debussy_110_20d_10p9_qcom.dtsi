/* Copyright (c) 2013, The Linux Foundation. All rights reserved.
 *
 * This program is free software; you can redistribute it and/or modify
 * it under the terms of the GNU General Public License version 2 and
 * only version 2 as published by the Free Software Foundation.
 *
 * This program is distributed in the hope that it will be useful,
 * but WITHOUT ANY WARRANTY; without even the implied warranty of
 * MERCHANTABILITY or FITNESS FOR A PARTICULAR PURPOSE.  See the
 * GNU General Public License for more details.
 */

/*-------------------------------------------------------------------------
 * This file is autogenerated file using gcdb parser. Please do not edit it.
 * Update input XML file to add a new entry or update variable in this file
 * VERSION = 1.1
 *-----------------------------------------------------------------------*/
&mdss_mdp {
	dsi_debussy_110_20d_10p9_qcom: lcd_kit_debussy_110_20d_10p9_qcom {
		compatible = "110_20d";
		lcd-kit,panel-name = "110_20d VIDEO 1600 x 2560";
		lcd-kit,panel-type = <0x01>;
		lcd-kit,tp-color-cmds = [15 01 00 00 0a 00 02 FF 22
		06 01 00 00 0a 00 01 0A
		15 01 00 00 0a 00 02 FF 10];
		lcd-kit,check-reg-on-cmds = <0x06 0x01 0x00 0x00 0x0a 0x00 0x01 0x0a>;
		lcd-kit,check-reg-on-value = <0x9c>;
		lcd-kit,check-aod-reg-on-cmds = <0x06 0x01 0x00 0x00 0x0a 0x00 0x01 0x0a>;
		lcd-kit,check-aod-reg-on-value = <0xdc>;
		lcd-kit,check-reg-off-cmds = <0x06 0x01 0x00 0x00 0x0a 0x00 0x01 0x0a>;
		lcd-kit,check-reg-off-value = <0x08>;
		lcd-kit,check-reg-on-cmds-state = "dsi_lp_mode";
		lcd-kit,check-aod-reg-on-cmds-state = "dsi_lp_mode";
		lcd-kit,check-reg-off-cmds-state = "dsi_lp_mode";
		lcd-kit,project-id-cmds = [15 01 00 00 0a 00 02 FF 22
                06 01 00 00 0a 00 01 00
                06 01 00 00 0a 00 01 01
                06 01 00 00 0a 00 01 02
                06 01 00 00 0a 00 01 03
                06 01 00 00 0a 00 01 04
                06 01 00 00 0a 00 01 05
                06 01 00 00 0a 00 01 06
                06 01 00 00 0a 00 01 07
                06 01 00 00 0a 00 01 08
                06 01 00 00 0a 00 01 09
                15 01 00 00 0a 00 02 FF 10];
		lcd-kit,project-id-cmds-state = "dsi_lp_mode";
		lcd-kit,bl-after-frame = <0>;
		lcd-kit,cmd-async-support = <0>;
		lcd-kit,check-reg-on-support = <0>;
		lcd-kit,check-reg-on-support-dsm-report = <0>;
		lcd-kit,check-aod-reg-on-support = <0>;
		lcd-kit,check-aod-reg-on-support-dsm-report = <0>;
		lcd-kit,check-reg-off-support = <0>;
		lcd-kit,check-reg-off-support-dsm-report = <0>;
		lcd-kit,vtc-line-no-reset = <1>;
		qcom,mdss-dsi-panel-type = "dsi_video_mode";
		qcom,mdss-dsi-panel-name = "110_20d_10p95";
		qcom,mdss-pan-physical-width-dimension = <145>;
		qcom,mdss-pan-physical-height-dimension = <232>;
		qcom,dsi-ctrl-num = <0 1>;
		qcom,dsi-phy-num = <0 1>;
		qcom,panel-supply-entries = <&dsi_panel_pwr_supply>;
		qcom,mdss-dsi-virtual-channel-id = <0>;
		qcom,mdss-dsi-h-sync-pulse = <0>;
		qcom,mdss-dsi-bllp-eof-power-mode;
		qcom,mdss-dsi-bllp-power-mode;
		qcom,mdss-dsi-dma-schedule-line = <1>;
		qcom,mdss-dsi-bpp = <24>;
		qcom,mdss-dsi-color-order = "rgb_swap_rgb";
		qcom,mdss-dsi-underflow-color = <0xff>;
		qcom,mdss-dsi-border-color = <0>;
		qcom,mdss-dsi-traffic-mode = "burst_mode";
		qcom,mdss-dsi-lane-map = "lane_map_0123";
		qcom,mdss-dsi-lane-0-state;
		qcom,mdss-dsi-lane-1-state;
		qcom,mdss-dsi-lane-2-state;
		qcom,mdss-dsi-mdp-trigger = "none";
		qcom,mdss-dsi-dma-trigger = "trigger_sw";
		qcom,mdss-dsi-te-pin-select = <0>;
		qcom,mdss-dsi-t-clk-post = <0>;
		qcom,mdss-dsi-t-clk-pre = <0>;
		qcom,dsi-select-clocks = "mux_byte_clk0", "mux_pixel_clk0", "cphy_byte_clk0", "cphy_pixel_clk0";
		qcom,panel-cphy-mode;
		qcom,mdss-dsi-stream = <0>;
		qcom,mdss-dsi-lp11-init;
		lcd-kit,check-thread-support = <0>;
		lcd-kit,check-time-period = <5000>;
		lcd-kit,check-fold-support = <0>;
		lcd-kit,fold-low-power-support = <0>;
		lcd-kit,fold-height = <0>;
		lcd-kit,unfold-height = <0>;
		lcd-kit,power-support = <0>;
		lcd-kit,three-stage-poweron = <0>;
		qcom,apaod-lp2-need-sendcmd;
		lcd-kit,fold-lp-time = <0>;
		lcd-kit,fold-nolp-time = <0>;
		qcom,sublinks-count = <2>;
		qcom,lanes-per-sublink = <2>;
		qcom,mdss-dsi-panel-hdr-color-primaries = <14500 15500 32000 17000 15500 30000 8000 3000>;
		qcom,mdss-dsi-panel-peak-brightness = <4200000>;
		qcom,mdss-dsi-panel-blackness-level = <3230>;
		qcom,dynamic-mode-switch-type = "dynamic-resolution-switch-immediate";
		qcom,mdss-dsi-bl-pmic-control-type = "bl_ctrl_i2c_ic";
		qcom,bl-pmic-pwm-period-usecs = <100>;
		qcom,mdss-dsi-bl-min-level = <1>;
		qcom,mdss-dsi-bl-max-level = <4095>;
		qcom,esd-check-enabled;
		qcom,tp-esd-gpio-event;
		qcom,esd-gpio-detect-support;
		qcom,esd-only-gpio-detect;
		qcom,esd-gpio-detect-num0 = <135>;
		qcom,esd-gpio-normal-value0 = <0>;
		qcom,esd-gpio-detect-num1 = <136>;
		qcom,esd-gpio-normal-value1 = <0>;
		qcom,mdss-dsi-panel-status-command = [15 01 00 00 0A 00 02 FF 10
			15 01 00 00 0A 00 02 FB 01
			15 01 00 00 0A 00 02 B9 03
			15 01 00 00 0A 00 02 FF 25
			15 01 00 00 0A 00 02 FB 01
			06 01 00 00 0a 00 01 BB
			15 01 00 00 0A 00 02 FF 10
			15 01 00 00 0A 00 02 FB 01
			15 01 00 00 0A 00 02 B9 02
			15 01 00 00 0A 00 02 FF 25
			15 01 00 00 0A 00 02 FB 01
			06 01 00 00 0a 00 01 BB
			15 01 00 00 0A 00 02 FF 10];
		qcom,mdss-dsi-panel-status-command-state = "dsi_lp_mode";
		qcom,mdss-dsi-panel-status-check-mode = "reg_read";
		qcom,mdss-dsi-panel-status-read-length = <0 0 0 0 0 1 0 0 0 0 0 1 0>;
		qcom,mdss-dsi-panel-status-value = <0x00>, <0x00>;
		lcd-kit,power-on-stage = <1 1 1
				2 1 2
				3 1 2
				4 1 2
				11 1 10
				5 2 5
				5 1 5
				5 2 5
				5 1 20
				6 1 0>;
		lcd-kit,lp-on-stage = <7 1 5
				8 1 0>;
		lcd-kit,hs-off-stage = <7 0 0
				8 0 20>;
		lcd-kit,power-off-stage = <5 0 5
				6 0 10
				11 0 2
				4 0 5
				3 0 10
				2 0 0
				1 0 1>;
		lcd-kit,only-power-off-stage = <0 0 0>;
		lcd-kit,pt-support = <0>;
		lcd-kit,panel-on-always-reset = <1>;
		lcd-kit,lcd-iovcc = <2 6 1900000>;
		lcd-kit,lcd-vsp = <2 11 5700000>;
		lcd-kit,lcd-vsn = <2 12 5700000>;
		lcd-kit,lcd-reset = <2 38 0>;
		lcd-kit,lcd-vci-name = "vdd";
		lcd-kit,lcd-iovcc-name = "vddio";
		lcd-kit,project-id-support = <1>;
		lcd-kit,default-project-id = "W2599Z1100";
		lcd-kit,Does-lcd-poweron-tp = <1>;
		lcd-kit,sn-code-support = <1>;
		lcd-kit,oem-info-support = <1>;
		lcd-kit,oem-barcode-2d-support = <1>;
		lcd-kit,oem-barcode-2d-num-offset = <0>;
		lcd-kit,barcode-2d-cmds = <0x29 0x01 0x00 0x00 0x00 0x00 0x02 0xFF 0x22
                0x06 0x01 0x00 0x00 0x00 0x00 0x01 0x0B
                0x06 0x01 0x00 0x00 0x00 0x00 0x01 0x0C
                0x06 0x01 0x00 0x00 0x00 0x00 0x01 0x0D
                0x06 0x01 0x00 0x00 0x00 0x00 0x01 0x0E
                0x06 0x01 0x00 0x00 0x00 0x00 0x01 0x0F
                0x06 0x01 0x00 0x00 0x00 0x00 0x01 0x10
                0x06 0x01 0x00 0x00 0x00 0x00 0x01 0x11
                0x06 0x01 0x00 0x00 0x00 0x00 0x01 0x12
                0x06 0x01 0x00 0x00 0x00 0x00 0x01 0x13
                0x06 0x01 0x00 0x00 0x00 0x00 0x01 0x14
                0x06 0x01 0x00 0x00 0x00 0x00 0x01 0x15
                0x06 0x01 0x00 0x00 0x00 0x00 0x01 0x16
                0x06 0x01 0x00 0x00 0x00 0x00 0x01 0x17
                0x06 0x01 0x00 0x00 0x00 0x00 0x01 0x18
                0x06 0x01 0x00 0x00 0x00 0x00 0x01 0x19
                0x06 0x01 0x00 0x00 0x00 0x00 0x01 0x1A
                0x06 0x01 0x00 0x00 0x00 0x00 0x01 0x1B
                0x06 0x01 0x00 0x00 0x00 0x00 0x01 0x1C
                0x06 0x01 0x00 0x00 0x00 0x00 0x01 0x1D
                0x06 0x01 0x00 0x00 0x00 0x00 0x01 0x1E
                0x06 0x01 0x00 0x00 0x00 0x00 0x01 0x1F
                0x29 0x01 0x00 0x00 0x00 0x00 0x02 0xFF 0x10>;
		lcd-kit,barcode-2d-cmds-state = "dsi_lp_mode";
		lcd-kit,panel-getblmaxnit-type = <0>;
		lcd-kit,panel-blmaxnit-min-value = <400>;
		lcd-kit,inversion-support = <0>;
		lcd-kit,panel-gpio-offset = <1100>;
		lcd-kit,finger-unlock-state-support = <0>;
		lcd-kit,esd-reg-te-check = <0>;
		lcd-kit,panel-bl-max-nit = <450>;
		lcd-kit,panel-bl-min = <30>;
		lcd-kit,panel-bl-max = <3932>;
		lcd-kit,panel-bl-def = <3932>;
		lcd-kit,check-reg-support = <0>;
		lcd-kit,thp-proximity-support = <0>;
		lcd-kit,proximity-reset-delay-min = <65>;
		lcd-kit,lcd-power-down-vsp = <2 11 5000000>;
		lcd-kit,lcd-power-down-vsn = <2 12 5000000>;
		lcd-kit,backlight-order = <0>;
		lcd-kit,backlight-need-sync = <0>;
		lcd-kit,fps-support = <1>;
		lcd-kit,default-fps = <60>;
		lcd-kit,panel-support-fps-list = <30 60 120>;
		lcd-kit,fps-60-cmd = "vndservice call display.qservice 25 i32 0 i32 0";
		lcd-kit,fps-90-cmd = "vndservice call display.qservice 25 i32 2 i32 0";
		lcd-kit,fps-120-cmd = "vndservice call display.qservice 25 i32 1 i32 0";
		qcom,mdss-dsi-display-timings {
			timing@0 {
				qcom,mdss-dsi-panel-width = <800>;
				qcom,mdss-dsi-panel-height = <2560>;
				qcom,mdss-dsi-h-front-porch = <22>;
				qcom,mdss-dsi-h-back-porch = <20>;
				qcom,mdss-dsi-h-pulse-width = <20>;
				qcom,mdss-dsi-h-sync-skew = <0>;
				qcom,mdss-dsi-v-front-porch = <2853>;
				qcom,mdss-dsi-v-back-porch = <237>;
				qcom,mdss-dsi-v-pulse-width = <4>;
				qcom,mdss-dsi-panel-framerate = <60>;
				qcom,mdss-dsi-panel-phy-timings= [00 1C 08 07 27 2A 0A
				19 0A 02 04 00 17 0C];
				qcom,display-topology  = <2 0 2>;
				qcom,default-topology-index  = <0>;
				qcom,mdss-dsi-on-command = [
			39 01 00 00 00 00 02 FF 24
			39 01 00 00 00 00 02 FB 01
			39 01 00 00 00 00 02 92 49
			39 01 00 00 00 00 02 DB 71
			39 01 00 00 00 00 02 DC 49
			39 01 00 00 00 00 02 E0 49
			39 01 00 00 00 00 02 E2 49
			39 01 00 00 00 00 02 E4 49
			39 01 00 00 00 00 02 E6 49
			39 01 00 00 00 00 02 FF 25
			39 01 00 00 00 00 02 FB 01
			39 01 00 00 00 00 02 5B 00
			39 01 00 00 00 00 02 13 01
			39 01 00 00 00 00 02 14 1C
			39 01 00 00 00 00 02 BC 01
			39 01 00 00 00 00 02 BD 1C
			39 01 00 00 00 00 02 FF D0
			39 01 00 00 00 00 02 FB 01
			39 01 00 00 00 00 02 53 22
			39 01 00 00 00 00 02 54 02
			39 01 00 00 00 00 02 1C 99
			39 01 00 00 00 00 02 1D 09
			39 01 00 00 00 00 02 FF E0
			39 01 00 00 00 00 02 FB 01
			39 01 00 00 00 00 02 14 60
			39 01 00 00 00 00 02 16 C0
			39 01 00 00 00 00 02 4F 02
			39 01 00 00 00 00 02 FF F0
			39 01 00 00 00 00 02 FB 01
			39 01 00 00 00 00 02 3A 08
			39 01 00 00 00 00 02 FF 26
			39 01 00 00 00 00 02 FB 01
			39 01 00 00 00 00 02 02 21
			39 01 00 00 00 00 02 1E 49
			39 01 00 00 00 00 02 1F 49
			39 01 00 00 00 00 02 25 49
			39 01 00 00 00 00 02 2F 0B
			39 01 00 00 00 00 02 30 49
			39 01 00 00 00 00 02 31 0B
			39 01 00 00 00 00 02 32 59
			39 01 00 00 00 00 02 3A 49
			39 01 00 00 00 00 02 35 66
			39 01 00 00 00 00 02 36 66
			39 01 00 00 00 00 02 37 66
			39 01 00 00 00 00 02 38 06
			39 01 00 00 00 00 02 00 81
			39 01 00 00 00 00 02 01 B0
			39 01 00 00 00 00 02 FF 22
			39 01 00 00 00 00 02 FB 01
			39 01 00 00 00 00 02 9F 50
			39 01 00 00 00 00 02 6F 01
			39 01 00 00 00 00 02 70 11
			39 01 00 00 00 00 02 73 01
			39 01 00 00 00 00 02 74 49
			39 01 00 00 00 00 02 76 01
			39 01 00 00 00 00 02 77 49
			39 01 00 00 00 00 02 A0 3F
			39 01 00 00 00 00 02 A9 50
			39 01 00 00 00 00 02 AA 28
			39 01 00 00 00 00 02 AB 28
			39 01 00 00 00 00 02 AD 10
			39 01 00 00 00 00 02 B8 00
			39 01 00 00 00 00 02 B9 49
			39 01 00 00 00 00 02 BA 92
			39 01 00 00 00 00 02 BB 49
			39 01 00 00 00 00 02 BE 07
			39 01 00 00 00 00 02 BF 49
			39 01 00 00 00 00 02 C0 07
			39 01 00 00 00 00 02 C1 59
			39 01 00 00 00 00 02 C2 00
			39 01 00 00 00 00 02 C5 00
			39 01 00 00 00 00 02 C6 00
			39 01 00 00 00 00 02 C7 30
			39 01 00 00 00 00 02 CA 00
			39 01 00 00 00 00 02 CB 3C
			39 01 00 00 00 00 02 CE 00
			39 01 00 00 00 00 02 CF 00
			39 01 00 00 00 00 02 D0 40
			39 01 00 00 00 00 02 D3 00
			39 01 00 00 00 00 02 D4 3C
			39 01 00 00 00 00 02 D7 00
			39 01 00 00 00 00 02 DC 00
			39 01 00 00 00 00 02 DD 40
			39 01 00 00 00 00 02 E1 00
			39 01 00 00 00 00 02 E2 40
			39 01 00 00 00 00 02 FF 2A
			39 01 00 00 00 00 02 FB 01
			39 01 00 00 00 00 02 23 0C
			39 01 00 00 00 00 02 24 01
			39 01 00 00 00 00 02 25 49
			39 01 00 00 00 00 02 30 49
			39 01 00 00 00 00 02 38 03
			39 01 00 00 00 00 02 39 49
			39 01 00 00 00 00 02 3D 1A
			39 01 00 00 00 00 02 97 3C
			39 01 00 00 00 00 02 98 02
			39 01 00 00 00 00 02 99 95
			39 01 00 00 00 00 02 9A 03
			39 01 00 00 00 00 02 9B 00
			39 01 00 00 00 00 02 9C 0B
			39 01 00 00 00 00 02 9D 0A
			39 01 00 00 00 00 02 9E 90
			39 01 00 00 00 00 02 FF 20
			39 01 00 00 00 00 02 FB 01
			39 01 00 00 00 00 02 5A 16
			39 01 00 00 00 00 02 FF 10
			39 01 00 00 00 00 02 FB 01
			39 01 00 00 00 00 02 B9 05
			39 01 00 00 00 00 02 FF 20
			39 01 00 00 00 00 02 FB 01
			39 01 00 00 00 00 02 18 40
			39 01 00 00 00 00 02 FF 10
			39 01 00 00 00 00 02 FB 01
			39 01 00 00 00 00 02 B9 02
			39 01 00 00 00 00 02 BB 13
			39 01 00 00 00 00 06 3B 03 F1 1A 04 04
			39 01 00 00 00 00 02 FF 10
			39 01 00 00 00 00 02 35 00
			05 01 00 00 32 00 01 11
			05 01 00 00 14 00 01 29
			39 01 00 00 00 00 02 FF F0
			39 01 00 00 00 00 02 FB 01
			39 01 00 00 00 00 02 84 08
			39 01 00 00 00 00 02 85 0C
			39 01 00 00 00 00 02 FF 20
			39 01 00 00 00 00 02 FB 01
			39 01 00 00 00 00 02 31 04
			39 01 00 00 00 00 02 32 44
			39 01 00 00 00 00 02 51 10
			39 01 00 00 00 00 02 FF 25
			39 01 00 00 00 00 02 FB 01
			39 01 00 00 00 00 02 91 1F
			39 01 00 00 00 00 02 92 0F
			39 01 00 00 00 00 02 93 01
			39 01 00 00 00 00 02 94 18
			39 01 00 00 00 00 02 95 03
			39 01 00 00 00 00 02 96 01
			39 01 00 00 00 00 02 FF 24
			39 01 00 00 00 00 02 FB 01
			39 01 00 00 00 00 02 B8 28
			39 01 00 00 00 00 02 FF 27
			39 01 00 00 00 00 02 FB 01
			39 01 00 00 00 00 02 D0 31
			39 01 00 00 00 00 02 D1 84
			39 01 00 00 00 00 02 D2 30
			39 01 00 00 00 00 02 DE 43
			39 01 00 00 00 00 02 DF 02
			39 01 00 00 00 00 02 FF 10];
				qcom,mdss-dsi-on-command-state = "dsi_lp_mode";
				qcom,mdss-dsi-off-command = [39 01 00 00 00 00 02 FF 10
			39 01 00 00 00 00 02 FB 01
			39 01 00 00 00 00 02 B9 02
			05 01 00 00 0A 00 01 28
			05 01 00 00 64 00 01 10];
				qcom,mdss-dsi-off-command-state = "dsi_lp_mode";
			};
		};
    };
};