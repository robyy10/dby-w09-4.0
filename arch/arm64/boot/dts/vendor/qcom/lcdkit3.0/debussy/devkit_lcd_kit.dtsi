/*---------------------------------------------------------------------------
 * This file is autogenerated file using huawei LCD parser. Please do not edit it.
 * Update input XML file to add a new entry or update variable in this file
 * Parser location: vendor/huawei/chipset_common/devkit/lcdkit/tools 
 *---------------------------------------------------------------------------*/


#include "debussy_110_20d_10p9_qcom.dtsi"
#include "debussy_110_a09_10p9_qcom.dtsi"
#include "debussy_190_20d_10p9_qcom.dtsi"
#include "debussy_290_20d_10p9_qcom.dtsi"
#include "debussy_dual_nt36523_video_mode_default.dtsi"