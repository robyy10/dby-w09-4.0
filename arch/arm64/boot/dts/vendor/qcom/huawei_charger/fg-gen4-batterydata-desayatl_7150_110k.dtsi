qcom,4975853_huawei_debussy_7150mah_PM8150B {
	/* #4975853_Huawei_Debussy_7150mAH_averaged_MasterSlave_Feb8th2021*/
        qcom,profile-revision = <24>;
	qcom,max-voltage-uv = <4400000>;
	qcom,fg-cc-cv-threshold-mv = <4390>;
	qcom,fastchg-current-ma = <5325>;
	qcom,nom-batt-capacity-mah = <7150>;
	qcom,batt-id-kohm = <110>;
	/* COLD = 0 DegC, HOT = 55 DegC */
	qcom,jeita-hard-thresholds = <0x3733 0xBC2>;
	/* COOL = 10 DegC, WARM = 45 DegC */
	qcom,jeita-soft-thresholds = <0x2AEE 0xFB4>;
	/* COOL hys = 13 DegC, WARM hys = 42 DegC */
	qcom,jeita-soft-hys-thresholds = <0x28DA 0x1134>;
	qcom,jeita-fcc-ranges = <0    50   715000
				 51   100  2145000
				 101  450  5000000
				 451  600  2500000>;
	qcom,jeita-fv-ranges = <0   50   4400000
				51  100  4400000
				101 450  4400000
				451 600  4100000>;
	qcom,jeita-soft-fcc-ua = <2145000 2500000>;
	qcom,jeita-soft-fv-uv = <4400000 4100000>;
	qcom,battery-beta = <3380>;
	qcom,therm-room-temp = <10000>;
	qcom,battery-type = "DesayAtl_7150mAH";
	qcom,therm-coefficients = <0x2302 0x15ad 0xf387 0xddd1 0x8bae>;
	qcom,therm-center-offset = <0x38>;
	qcom,therm-pull-up = <30>;
	qcom,rslow-normal-coeffs = <0xb8 0xd3 0x24 0x1a>;
	qcom,rslow-low-coeffs = <0x78 0x15 0x5c 0x0b>;
	qcom,checksum = <0xED75>;
	qcom,gui-version = "PM855GUI - 1.0.0.14";
	qcom,fg-profile-data = [
		 09 00 04 E3
		 28 D5 37 DA
		 E0 D5 00 00
		 03 B5 88 83
		 FB 87 F1 8B
		 24 94 33 80
		 15 00 B8 D3
		 24 1A 42 04
		 8F 02 CE 07
		 32 00 8A EB
		 2A ED 9E D5
		 1B 12 AF DC
		 10 C4 3D 13
		 E7 03 31 DA
		 60 00 4E 00
		 4E 00 4B 00
		 3E 00 2E 00
		 38 00 3C 00
		 3F 00 44 00
		 3B 00 60 00
		 31 00 37 00
		 42 00 3F 00
		 37 00 71 00
		 51 64 44 00
		 41 00 40 08
		 60 00 4A 00
		 4D 08 72 10
		 5D 10 52 00
		 9B 28 6E 50
		 5A 68 4C 0A
		 51 00 D8 F8
		 B5 1F 61 05
		 7E F2 7B 06
		 13 1C 14 0A
		 0A 0D 1B 23
		 6D 17 EB 42
		 C3 5D 62 02
		 67 0F A2 1E
		 8F 05 28 0B
		 A5 04 B9 1C
		 90 FA 97 04
		 F9 03 49 18
		 98 23 6F 44
		 72 52 61 11
		 4E 21 1A 04
		 5A C3 9F BD
		 E8 1C ED A2
		 FB 05 59 B2
		 07 18 70 8B
		 EF 84 BC 83
		 9D 98 09 80
		 2E 00 FF 0C
		 C1 03 40 FA
		 00 00 00 DD
		 10 EA F9 F7
		 C6 E1 6D C5
		 4C 18 0F 00
		 DC E6 1C 02
		 00 05 ED 03
		 CE 07 32 00
		 93 01 70 03
		 43 05 2A 02
		 8C 02 9B 02
		 29 02 32 02
		 FB 04 50 00
		 39 00 41 00
		 42 64 46 00
		 43 00 42 00
		 47 F0 45 00
		 46 00 44 10
		 3C 10 3B 00
		 4B 28 4B 48
		 53 60 5E 0C
		 40 00 46 00
		 53 08 63 00
		 4B 00 42 00
		 48 10 58 10
		 50 00 61 20
		 7A 48 47 58
		 56 0D 65 00
		 66 00 3D 08
		 D8 00 73 1F
		 60 06 58 03
		 81 0C BA 1C
		 94 23 86 45
		 99 52 59 18
		 4E 02 10 05
		 99 02 64 11
		 3F 0A A6 1F
		 D6 05 42 02
		 7F 06 B5 1C
		 59 03 B1 05
		 7E 02 79 18
		 F9 03 C1 05
		 87 03 66 00
		 AA 20 A7 04
		 24 03 AD 05
		 F8 1C EE 01
		 3C 04 06 02
		 9E 18 32 03
		 19 05 A2 03
		 86 00 18 01
		 C0 00 FA 00
		 80 1C 00 00
	];
};