qcom,4980919_huawei_debussy_7150mah_PM8150B {
	/* #4980919_Huawei_Debussy_7150mAH_averaged_MasterSlave_Feb1st2021*/
        qcom,profile-revision = <24>;
	qcom,max-voltage-uv = <4400000>;
	qcom,fg-cc-cv-threshold-mv = <4390>;
	qcom,fastchg-current-ma = <5325>;
	qcom,nom-batt-capacity-mah = <7150>;
	qcom,batt-id-kohm = <200>;
	/* COLD = 0 DegC, HOT = 55 DegC */
	qcom,jeita-hard-thresholds = <0x3733 0xBC2>;
	/* COOL = 10 DegC, WARM = 45 DegC */
	qcom,jeita-soft-thresholds = <0x2AEE 0xFB4>;
	/* COOL hys = 13 DegC, WARM hys = 42 DegC */
	qcom,jeita-soft-hys-thresholds = <0x28DA 0x1134>;
	qcom,jeita-fcc-ranges = <0    50   715000
				 51   100  2145000
				 101  450  5000000
				 451  600  2500000>;
	qcom,jeita-fv-ranges = <0   50   4400000
				51  100  4400000
				101 450  4400000
				451 600  4100000>;
	qcom,jeita-soft-fcc-ua = <2145000 2500000>;
	qcom,jeita-soft-fv-uv = <4400000 4100000>;
	qcom,battery-beta = <3435>;
	qcom,therm-room-temp = <10000>;
	qcom,battery-type = "SunwodaCosmx_7150mAH";
	qcom,therm-coefficients = <0x2307 0x1575 0xf2 0xdd8c 0x9272>;
	qcom,therm-center-offset = <0x38>;
	qcom,therm-pull-up = <30>;
	qcom,rslow-normal-coeffs = <0x0d 0xfb 0xb0 0x13>;
	qcom,rslow-low-coeffs = <0x01 0x12 0xe2 0x1a>;
	qcom,checksum = <0x2C69>;
	qcom,gui-version = "PM855GUI - 1.0.0.14";
	qcom,fg-profile-data = [
		 09 00 36 E3
		 5F DD 4F E2
		 7C DD 00 00
		 C4 B4 0D 83
		 FE 87 7B 92
		 77 8C 10 80
		 0F 00 0D FB
		 B0 13 4D 05
		 36 01 CE 07
		 32 00 D7 EA
		 BA 07 B8 DA
		 36 12 87 DC
		 FD C4 10 1B
		 BB FB 3D B5
		 60 00 40 00
		 3E 00 3D 00
		 2C 00 2F 00
		 36 00 48 00
		 41 00 42 00
		 3E 00 60 00
		 31 00 3C 00
		 4B 00 44 00
		 3E 00 8E 00
		 5E 64 49 00
		 43 00 45 08
		 60 00 64 00
		 65 00 98 10
		 7D 10 6F 00
		 D9 28 99 48
		 7A 60 6C 0C
		 6E 00 D8 00
		 B8 1F 56 0D
		 A3 02 3C 06
		 63 1C 60 0B
		 AC 0D 7F 22
		 C9 17 68 42
		 EB 5C BB 02
		 6A 10 44 1F
		 02 06 2B 0A
		 9A FE E0 1C
		 08 FA A6 05
		 AF 02 58 18
		 6D 23 CA 44
		 12 52 72 12
		 BA 1F 8E E5
		 7B CA 9B CC
		 E2 1C 39 C3
		 3E 05 34 B3
		 34 18 39 8B
		 38 85 4B 8B
		 86 98 09 80
		 FC F2 B2 0D
		 B6 02 88 FD
		 00 00 5D DC
		 89 EA F7 FF
		 2F E2 10 C5
		 5F 10 0C F8
		 72 E5 33 03
		 37 05 9B 03
		 CE 07 32 00
		 97 01 B2 03
		 46 05 1D 03
		 53 02 3E 02
		 FA 03 F3 03
		 37 05 52 00
		 38 00 41 00
		 45 64 48 00
		 45 F8 43 00
		 49 F0 46 00
		 4A 00 49 08
		 3F 10 3C 00
		 52 28 52 48
		 5A 60 6B 0D
		 48 00 4D 00
		 5C 08 6B F8
		 54 00 49 00
		 52 10 66 10
		 5D 00 6F 20
		 8F 48 56 58
		 63 0E 70 00
		 71 00 43 08
		 D8 F8 64 1F
		 05 05 05 0B
		 52 0D E0 1C
		 10 23 03 44
		 0C 52 75 18
		 23 02 7A 05
		 10 02 6A 10
		 3F 0A D8 1F
		 84 05 89 02
		 71 04 CA 1C
		 0D 03 ED 05
		 3F 02 85 18
		 DA 03 E5 05
		 32 03 6A 00
		 AE 1F 9C 05
		 8A 02 57 04
		 E1 1C 49 02
		 56 05 F3 02
		 A3 18 3B 03
		 FD 04 E0 03
		 73 00 15 01
		 C0 00 FA 00
		 84 1C 00 00
	];
};
