#include "../../common/common.dtsi"
#include "huawei-lcd.dtsi"
#include "huawei_charger.dtsi"
#include "huawei_audio.dtsi"
#include "huawei_tp.dtsi"
#include "huawei-sensor.dtsi"
#include "huawei_camera.dtsi"
#include "huawei_btkb_led.dtsi"
#include "huawei_pogopin.dtsi"
#include "huawei_dp.dtsi"
