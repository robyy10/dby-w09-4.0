/* Copyright (c) 2013, The Linux Foundation. All rights reserved.
 *
 * This program is free software; you can redistribute it and/or modify
 * it under the terms of the GNU General Public License version 2 and
 * only version 2 as published by the Free Software Foundation.
 *
 * This program is distributed in the hope that it will be useful,
 * but WITHOUT ANY WARRANTY; without even the implied warranty of
 * MERCHANTABILITY or FITNESS FOR A PARTICULAR PURPOSE.  See the
 * GNU General Public License for more details.
 */

/*-------------------------------------------------------------------------
 * This file is autogenerated file using gcdb parser. Please do not edit it.
 * Update input XML file to add a new entry or update variable in this file
 * VERSION = 1.1
 *-----------------------------------------------------------------------*/
&mdss_mdp {
	dsi_dual_nt36523_cost_video: qcom,mdss_dsi_nt36523_wqxga_video_cost {
		compatible = "dual_nt36523";
		lcd-kit,panel-name = "dual_nt36523' VIDEO 1600 x 2560";
		lcd-kit,panel-type = <0x01>;
		qcom,mdss-dsi-panel-type = "dsi_video_mode";
		qcom,mdss-dsi-panel-name = "dual_nt36523' VIDEO 1600 x 2560";
		qcom,mdss-pan-physical-width-dimension = <145>;
		qcom,mdss-pan-physical-height-dimension = <232>;
		qcom,dsi-ctrl-num = <0 1>;
		qcom,dsi-phy-num = <0 1>;
		qcom,panel-supply-entries = <&dsi_panel_pwr_supply>;
		qcom,mdss-dsi-virtual-channel-id = <0>;
		qcom,mdss-dsi-h-sync-pulse = <0>;
		qcom,mdss-dsi-bllp-eof-power-mode;
		qcom,mdss-dsi-bllp-power-mode;
		qcom,mdss-dsi-dma-schedule-line = <1>;
		qcom,mdss-dsi-bpp = <24>;
		qcom,mdss-dsi-color-order = "rgb_swap_rgb";
		qcom,mdss-dsi-underflow-color = <0xff>;
		qcom,mdss-dsi-border-color = <0>;
		qcom,mdss-dsi-traffic-mode = "burst_mode";
		qcom,mdss-dsi-lane-map = "lane_map_0123";
		qcom,mdss-dsi-lane-0-state;
		qcom,mdss-dsi-lane-1-state;
		qcom,mdss-dsi-lane-2-state;
		qcom,mdss-dsi-mdp-trigger = "none";
		qcom,mdss-dsi-dma-trigger = "trigger_sw";
		qcom,mdss-dsi-te-pin-select = <1>;
		qcom,mdss-dsi-t-clk-post = <0>;
		qcom,mdss-dsi-t-clk-pre = <0>;
		qcom,dsi-select-clocks = "mux_byte_clk0", "mux_pixel_clk0", "cphy_byte_clk0", "cphy_pixel_clk0";
		qcom,panel-cphy-mode;
		qcom,mdss-dsi-stream = <0>;
		qcom,mdss-dsi-lp11-init;
		qcom,sublinks-count = <2>;
		qcom,lanes-per-sublink = <2>;
		qcom,mdss-dsi-panel-hdr-color-primaries = <14500 15500 32000 17000 15500 30000 8000 3000>;
		qcom,mdss-dsi-panel-peak-brightness = <4200000>;
		qcom,mdss-dsi-panel-blackness-level = <3230>;
		qcom,dynamic-mode-switch-type = "dynamic-resolution-switch-immediate";
		qcom,mdss-dsi-bl-pmic-control-type = "bl_ctrl_i2c_ic";
		qcom,bl-pmic-pwm-period-usecs = <100>;
		qcom,mdss-dsi-bl-min-level = <1>;
		qcom,mdss-dsi-bl-max-level = <4095>;
		lcd-kit,power-on-stage = <2 1 0
				3 1 2
				4 1 2
				11 1 0
				5 1 2
				5 0 1
				5 1 2>;
		lcd-kit,lp-on-stage = <6 1 0>;
		lcd-kit,lp-off-stage = <0 0 0>;
		lcd-kit,power-off-stage = <5 0 2
				11 0 2
				4 0 1
				3 0 2
				2 0 0>;
		lcd-kit,only-power-off-stage = <0 0 0>;
		lcd-kit,lcd-iovcc = <1 4 1800000 1800000 1800000 62000 80>;
		lcd-kit,lcd-vsp = <2 11 5500000>;
		lcd-kit,lcd-vsn = <2 12 5500000>;
		lcd-kit,lcd-reset = <2 38 0>;
		lcd-kit,lcd-iovcc-name = "vddio";
		lcd-kit,project-id-support = <0>;
		lcd-kit,default-project-id = "G21579250";
		lcd-kit,panel-getblmaxnit-type = <0>;
		lcd-kit,panel-blmaxnit-min-value = <400>;
		lcd-kit,inversion-support = <0>;
		lcd-kit,panel-gpio-offset = <1100>;
		lcd-kit,panel-bl-max-nit = <450>;
		lcd-kit,panel-bl-min = <45>;
		lcd-kit,panel-bl-max = <10000>;
		lcd-kit,check-reg-support = <0>;
		lcd-kit,thp-proximity-support = <0>;
		lcd-kit,proximity-reset-delay-min = <65>;
		qcom,mdss-dsi-display-timings {
			timing@0 {
				qcom,mdss-dsi-panel-width = <800>;
				qcom,mdss-dsi-panel-height = <2560>;
				qcom,mdss-dsi-h-front-porch = <22>;
				qcom,mdss-dsi-h-back-porch = <20>;
				qcom,mdss-dsi-h-pulse-width = <10>;
				qcom,mdss-dsi-h-sync-skew = <0>;
				qcom,mdss-dsi-v-front-porch = <26>;
				qcom,mdss-dsi-v-back-porch = <241>;
				qcom,mdss-dsi-v-pulse-width = <4>;
				qcom,mdss-dsi-panel-framerate = <60>;
				qcom,mdss-dsi-panel-phy-timings= [00 1C 08 07 27 2A 0A
				19 0A 02 04 00 17 0C];
				qcom,display-topology  = <2 0 2>;
				qcom,default-topology-index  = <0>;
				qcom,mdss-dsi-on-command = [
			39 01 00 00 00 00 02 FF 10
			39 01 00 00 00 00 02 FB 01
			39 01 00 00 00 00 02 B9 05
			39 01 00 00 00 00 02 FF 20
			39 01 00 00 00 00 02 FB 01
			39 01 00 00 00 00 02 18 40
			39 01 00 00 00 00 02 FF 20
			39 01 00 00 00 00 02 FB 01
			39 01 00 00 00 00 02 FF 10
			39 01 00 00 00 00 02 FB 01
			39 01 00 00 00 00 02 B9 02
			39 01 00 00 00 00 02 FF D0
			39 01 00 00 00 00 02 FB 01
			39 01 00 00 00 00 02 00 30
			39 01 00 00 00 00 02 09 EE
			39 01 00 00 00 00 02 1C AA
			39 01 00 00 00 00 02 1D 0A
			39 01 00 00 00 00 02 FF F0
			39 01 00 00 00 00 02 FB 01
			39 01 00 00 00 00 02 3A 08
			39 01 00 00 00 00 02 FF E0
			39 01 00 00 00 00 02 FB 01
			39 01 00 00 00 00 02 4F 02
			39 01 00 00 00 00 02 FF 10
			39 01 00 00 00 00 02 FB 01
			39 01 00 00 00 00 02 35 00
			39 01 00 00 00 00 03 51 00 00
			39 01 00 00 00 00 02 53 2C
			39 01 00 00 00 00 02 55 00
			39 01 00 00 00 00 06 3B 03 F1 1A 04 04
			05 01 00 00 78 00 01 11
			05 01 00 00 14 00 01 29];
				qcom,mdss-dsi-on-command-state = "dsi_lp_mode";
				qcom,mdss-dsi-off-command = [05 01 00 00 78 00
			02 28 00 05 01 00 00 78 00 02 10 00];
				qcom,mdss-dsi-off-command-state = "dsi_lp_mode";
			};
		};
    };
};
