
qcom,4980913_huawei_marxr_7150mah_averaged_masterslave_feb7th2021 {
	qcom,profile-revision = <24>;
	/* #4980913_Huawei_MarxR_7150mAH_averaged_MasterSlave_Feb7th2021*/
	qcom,max-voltage-uv = <4400000>;
	qcom,fg-cc-cv-threshold-mv = <4390>;
	qcom,fastchg-current-ma = <5325>;
	qcom,nom-batt-capacity-mah = <7150>;
	qcom,batt-id-kohm = <39>;
	/* COLD = 0 DegC, HOT = 45 DegC */
	qcom,jeita-hard-thresholds = <0x3733 0xEB1>;
	/* COOL = 10 DegC, WARM = 40 DegC */
	qcom,jeita-soft-thresholds = <0x2AEE 0x114E>;
	/* COOL hys = 13 DegC, WARM hys = 42 DegC */
	qcom,jeita-soft-hys-thresholds = <0x28DA 0x1134>;
	qcom,jeita-fcc-ranges = <0    50   715000
				 51   100  2145000
				 101  450  5000000
				 451  600  2500000>;
	qcom,jeita-fv-ranges = <0   50   4400000
				51  100  4400000
				101 450  4400000
				451 600  4100000>;
	qcom,jeita-soft-fcc-ua = <2145000 2500000>;
	qcom,jeita-soft-fv-uv = <4400000 4100000>;
	qcom,battery-beta = <3800>;
	qcom,therm-room-temp = <10000>;
	qcom,battery-type = "dynaatl_7150_39k";
	qcom,therm-coefficients = <0x2302 0x15ad 0xf387 0xddd1 0x8bae>;
	qcom,therm-center-offset = <0x38>;
	qcom,therm-pull-up = <30>;
	qcom,rslow-normal-coeffs = <0x9e 0xdd 0x97 0x13>;
	qcom,rslow-low-coeffs = <0xbf 0x15 0x8b 0x0a>;
	qcom,checksum = <0x6511>;
	qcom,gui-version = "PM855GUI - 1.0.0.14";
	qcom,fg-profile-data = [
		 09 00 32 E2
		 71 CC 7D D2
		 CD CD 00 00
		 F7 B4 54 83
		 FC 87 69 92
		 00 95 1F 80
		 1D 00 9E DD
		 97 13 10 05
		 A5 FB CE 07
		 32 00 36 EB
		 64 ED 23 AD
		 23 12 2D E5
		 F7 CD 04 1A
		 1F 0A 21 DA
		 60 00 50 00
		 4D 00 49 00
		 36 00 2E 00
		 37 00 3F 00
		 40 00 43 00
		 3D 00 60 00
		 2E 00 3A 00
		 46 00 41 00
		 3B 00 7C 00
		 56 64 46 00
		 41 00 43 08
		 60 00 46 00
		 4A 00 6D 10
		 59 10 4F 00
		 94 28 68 48
		 56 60 4B 0B
		 4C 00 D8 00
		 75 1F AF 0D
		 4B 02 A6 06
		 28 1C ED 03
		 36 0D F9 22
		 8D 17 A3 42
		 54 54 8C 03
		 65 11 62 1F
		 F9 FD 26 02
		 A7 F6 E4 1C
		 D7 01 46 04
		 19 02 25 18
		 60 23 03 45
		 A3 53 7B 12
		 AC 1E A3 E5
		 13 BB CB BC
		 D4 1C CC C1
		 AB 04 CC B3
		 32 18 34 8B
		 3F 85 42 8B
		 77 98 09 80
		 1E 02 A9 04
		 80 04 18 03
		 00 F8 DE DC
		 08 EA F9 E7
		 30 C2 7A BD
		 3E 18 17 00
		 54 E6 60 02
		 74 05 93 01
		 CE 07 32 00
		 25 03 5B 02
		 5D 05 23 04
		 36 03 80 03
		 00 03 E0 02
		 87 05 51 00
		 39 00 41 00
		 43 64 47 00
		 46 00 42 00
		 47 00 45 00
		 46 00 40 10
		 3E 10 3C 00
		 4D 28 4E 48
		 57 60 63 0B
		 44 00 4A 00
		 56 08 67 F8
		 4B 00 42 00
		 4A 10 5B 10
		 52 00 65 20
		 7E 48 4B 58
		 5B 0D 67 00
		 60 00 3D 08
		 D8 F8 5A 1F
		 7A 06 3A 0B
		 2E 0F A0 1C
		 E7 23 36 45
		 FB 52 43 18
		 67 02 D0 04
		 F1 02 60 11
		 3F 0A 6F 1F
		 1C 06 0D 02
		 67 05 B3 1C
		 63 03 A2 05
		 97 02 7B 18
		 F7 03 C3 05
		 85 03 63 00
		 DA 1F 94 05
		 79 02 9B 04
		 F1 1C 07 02
		 EF 05 3D 02
		 A5 18 2A 03
		 21 05 97 03
		 7D 00 AE 00
		 C0 00 FA 00
		 83 1C 00 00
	];
};
