
qcom,4980916_huawei_marxr_7150mah_averaged_masterslave_feb9th2021 {
	qcom,profile-revision = <24>;
	/* #4980916_Huawei_MarxR_7150mAH_averaged_MasterSlave_Feb9th2021*/
	qcom,max-voltage-uv = <4400000>;
	qcom,fg-cc-cv-threshold-mv = <4390>;
	qcom,fastchg-current-ma = <5325>;
	qcom,nom-batt-capacity-mah = <7150>;
	qcom,batt-id-kohm = <68>;
	/* COLD = 0 DegC, HOT = 45 DegC */
	qcom,jeita-hard-thresholds = <0x3733 0xEB1>;
	/* COOL = 10 DegC, WARM = 40 DegC */
	qcom,jeita-soft-thresholds = <0x2AEE 0x114E>;
	/* COOL hys = 13 DegC, WARM hys = 42 DegC */
	qcom,jeita-soft-hys-thresholds = <0x28DA 0x1134>;
	qcom,jeita-fcc-ranges = <0    50   715000
				 51   100  2145000
				 101  450  5000000
				 451  600  2500000>;
	qcom,jeita-fv-ranges = <0   50   4400000
				51  100  4400000
				101 450  4400000
				451 600  4100000>;
	qcom,jeita-soft-fcc-ua = <2145000 2500000>;
	qcom,jeita-soft-fv-uv = <4400000 4100000>;
	qcom,battery-beta = <3800>;
	qcom,therm-room-temp = <10000>;
	qcom,battery-type = "scudliwinon_7150_68k";
	qcom,therm-coefficients = <0x2302 0x15ad 0xf387 0xddd1 0x8bae>;
	qcom,therm-center-offset = <0x38>;
	qcom,therm-pull-up = <30>;
	qcom,rslow-normal-coeffs = <0x9d 0x03 0xa4 0x13>;
	qcom,rslow-low-coeffs = <0x21 0x15 0x8b 0xf3>;
	qcom,checksum = <0x5464>;
	qcom,gui-version = "PM855GUI - 1.0.0.14";
	qcom,fg-profile-data = [
		 09 00 9E E2
		 F2 D5 7F D3
		 40 CC 00 00
		 DF B4 23 87
		 0F 80 49 86
		 F8 8C 39 80
		 18 00 9D 03
		 A4 13 53 02
		 79 0D CE 07
		 32 00 4A EA
		 FE ED D9 DB
		 D6 0A 32 ED
		 8F C5 E5 1A
		 39 0A 2E DA
		 60 00 4C 00
		 48 00 3E 00
		 30 00 33 00
		 3A 00 45 00
		 43 00 44 00
		 3F 00 60 00
		 38 00 3E 00
		 50 00 49 00
		 42 00 93 00
		 63 64 4F 00
		 45 00 43 08
		 60 F8 5D 00
		 5A 00 90 10
		 78 10 6A 00
		 D5 28 8F 48
		 77 58 69 0D
		 68 00 D8 00
		 B4 1F 4A 0D
		 C0 02 23 FC
		 65 1C 57 03
		 B0 0D 84 22
		 06 18 0D 42
		 AE 55 A6 03
		 69 11 33 20
		 EA 04 09 0B
		 BD 05 EF 1C
		 81 FB 81 04
		 06 02 3D 18
		 6D 23 DE 44
		 EC 53 81 12
		 BC 1F 71 E5
		 AF C2 06 AE
		 D5 1C 7B BB
		 DD 04 A0 BB
		 F9 17 5A 8B
		 1C 85 6C 83
		 81 98 09 80
		 74 FA 66 05
		 56 FB 0B F3
		 00 F8 B5 E5
		 FC EA F6 07
		 96 D5 A0 BC
		 8C 10 14 F8
		 E7 DD E4 03
		 2B 04 12 03
		 CE 07 32 00
		 01 03 2C 02
		 79 05 B5 00
		 30 03 8A 02
		 9C 02 2B 02
		 94 05 4A 00
		 38 00 44 00
		 48 64 4D 00
		 4C 00 4C 00
		 4D F0 4B 00
		 4E 00 42 08
		 3D 08 3C 00
		 50 20 54 40
		 5B 58 6B 0E
		 4F 00 54 00
		 5E 08 6A 00
		 53 00 46 00
		 4F 10 67 10
		 60 00 73 20
		 92 40 5D 58
		 69 0E 73 00
		 7B 08 53 10
		 D8 08 92 1F
		 41 FE 8D 03
		 12 04 E5 1C
		 EC 22 59 44
		 B9 53 8D 18
		 C8 03 01 04
		 ED 02 6E 11
		 3F 0A 13 20
		 28 05 E9 02
		 C9 05 C1 1C
		 16 03 ED 05
		 40 02 7F 18
		 B8 03 15 04
		 DE 02 6B 00
		 F4 23 91 04
		 D2 02 B4 05
		 02 1D 59 03
		 3E 05 13 03
		 91 18 3E 03
		 0B 05 B5 03
		 9C 00 B0 00
		 C0 00 FA 00
		 54 1C 00 00
	];
};
