/* Copyright (c) 2013, The Linux Foundation. All rights reserved.
 *
 * This program is free software; you can redistribute it and/or modify
 * it under the terms of the GNU General Public License version 2 and
 * only version 2 as published by the Free Software Foundation.
 *
 * This program is distributed in the hope that it will be useful,
 * but WITHOUT ANY WARRANTY; without even the implied warranty of
 * MERCHANTABILITY or FITNESS FOR A PARTICULAR PURPOSE.  See the
 * GNU General Public License for more details.
 */

/*-------------------------------------------------------------------------
 * This file is autogenerated file using gcdb parser. Please do not edit it.
 * Update input XML file to add a new entry or update variable in this file
 * VERSION = 1.1
 *-----------------------------------------------------------------------*/
&mdss_mdp {
	dsi_debussy_110_a09_10p9_qcom: lcd_kit_debussy_110_a09_10p9_qcom {
		compatible = "110_a09";
		lcd-kit,panel-name = "110_a09 VIDEO 1600 x 2560";
		lcd-kit,panel-type = <0x01>;
		lcd-kit,tp-color-cmds = [39 01 00 00 00 00 04 FF 98 82 0B
		06 01 00 00 0a 00 01 0A];
		lcd-kit,check-reg-on-cmds = <0x06 0x01 0x00 0x00 0x0a 0x00 0x01 0x0a>;
		lcd-kit,check-reg-on-value = <0x9c>;
		lcd-kit,check-aod-reg-on-cmds = <0x06 0x01 0x00 0x00 0x0a 0x00 0x01 0x0a>;
		lcd-kit,check-aod-reg-on-value = <0xdc>;
		lcd-kit,check-reg-off-cmds = <0x06 0x01 0x00 0x00 0x0a 0x00 0x01 0x0a>;
		lcd-kit,check-reg-off-value = <0x08>;
		lcd-kit,check-reg-on-cmds-state = "dsi_lp_mode";
		lcd-kit,check-aod-reg-on-cmds-state = "dsi_lp_mode";
		lcd-kit,check-reg-off-cmds-state = "dsi_lp_mode";
		lcd-kit,project-id-cmds = [39 01 00 00 00 00 04 FF 98 82 0B
                06 01 00 00 0a 00 01 00
                06 01 00 00 0a 00 01 01
                06 01 00 00 0a 00 01 02
                06 01 00 00 0a 00 01 03
                06 01 00 00 0a 00 01 04
                06 01 00 00 0a 00 01 05
                06 01 00 00 0a 00 01 06
                06 01 00 00 0a 00 01 07
                06 01 00 00 0a 00 01 08
                06 01 00 00 0a 00 01 09];
		lcd-kit,project-id-cmds-state = "dsi_lp_mode";
		lcd-kit,bl-after-frame = <0>;
		lcd-kit,cmd-async-support = <0>;
		lcd-kit,check-reg-on-support = <0>;
		lcd-kit,check-reg-on-support-dsm-report = <0>;
		lcd-kit,check-aod-reg-on-support = <0>;
		lcd-kit,check-aod-reg-on-support-dsm-report = <0>;
		lcd-kit,check-reg-off-support = <0>;
		lcd-kit,check-reg-off-support-dsm-report = <0>;
		lcd-kit,vtc-line-no-reset = <1>;
		qcom,mdss-dsi-panel-type = "dsi_video_mode";
		qcom,mdss-dsi-panel-name = "w259_110_a09_10p95";
		qcom,mdss-pan-physical-width-dimension = <145>;
		qcom,mdss-pan-physical-height-dimension = <232>;
		qcom,dsi-ctrl-num = <0 1>;
		qcom,dsi-phy-num = <0 1>;
		qcom,panel-supply-entries = <&dsi_panel_pwr_supply>;
		qcom,mdss-dsi-virtual-channel-id = <0>;
		qcom,mdss-dsi-h-sync-pulse = <0>;
		qcom,mdss-dsi-bllp-eof-power-mode;
		qcom,mdss-dsi-bllp-power-mode;
		qcom,mdss-dsi-dma-schedule-line = <1>;
		qcom,mdss-dsi-bpp = <24>;
		qcom,mdss-dsi-color-order = "rgb_swap_rgb";
		qcom,mdss-dsi-underflow-color = <0xff>;
		qcom,mdss-dsi-border-color = <0>;
		qcom,mdss-dsi-traffic-mode = "burst_mode";
		qcom,mdss-dsi-lane-map = "lane_map_0123";
		qcom,mdss-dsi-lane-0-state;
		qcom,mdss-dsi-lane-1-state;
		qcom,mdss-dsi-lane-2-state;
		qcom,mdss-dsi-mdp-trigger = "none";
		qcom,mdss-dsi-dma-trigger = "trigger_sw";
		qcom,mdss-dsi-te-pin-select = <0>;
		qcom,mdss-dsi-t-clk-post = <0>;
		qcom,mdss-dsi-t-clk-pre = <0>;
		qcom,dsi-select-clocks = "mux_byte_clk0", "mux_pixel_clk0", "cphy_byte_clk0", "cphy_pixel_clk0";
		qcom,panel-cphy-mode;
		qcom,mdss-dsi-stream = <0>;
		qcom,mdss-dsi-lp11-init;
		lcd-kit,check-thread-support = <0>;
		lcd-kit,check-time-period = <5000>;
		lcd-kit,check-fold-support = <0>;
		lcd-kit,fold-low-power-support = <0>;
		lcd-kit,fold-height = <0>;
		lcd-kit,unfold-height = <0>;
		lcd-kit,power-support = <0>;
		lcd-kit,three-stage-poweron = <0>;
		qcom,apaod-lp2-need-sendcmd;
		lcd-kit,fold-lp-time = <0>;
		lcd-kit,fold-nolp-time = <0>;
		qcom,sublinks-count = <2>;
		qcom,lanes-per-sublink = <2>;
		qcom,mdss-dsi-panel-hdr-color-primaries = <14500 15500 32000 17000 15500 30000 8000 3000>;
		qcom,mdss-dsi-panel-peak-brightness = <4200000>;
		qcom,mdss-dsi-panel-blackness-level = <3230>;
		qcom,dynamic-mode-switch-type = "dynamic-resolution-switch-immediate";
		qcom,mdss-dsi-bl-pmic-control-type = "bl_ctrl_i2c_ic";
		qcom,bl-pmic-pwm-period-usecs = <100>;
		qcom,mdss-dsi-bl-min-level = <1>;
		qcom,mdss-dsi-bl-max-level = <4095>;
		qcom,esd-check-enabled;
		qcom,tp-esd-gpio-event;
		qcom,esd-gpio-detect-support;
		qcom,esd-only-gpio-detect;
		qcom,esd-detect-one-gpio;
		qcom,esd-gpio-detect-num0 = <135>;
		qcom,esd-gpio-normal-value0 = <0>;
		qcom,mdss-dsi-panel-status-command = [15 01 00 00 0A 00 02 FF 10
			15 01 00 00 0A 00 02 FB 01
			15 01 00 00 0A 00 02 B9 03
			15 01 00 00 0A 00 02 FF 25
			15 01 00 00 0A 00 02 FB 01
			06 01 00 00 0a 00 01 BB
			15 01 00 00 0A 00 02 FF 10
			15 01 00 00 0A 00 02 FB 01
			15 01 00 00 0A 00 02 B9 02
			15 01 00 00 0A 00 02 FF 25
			15 01 00 00 0A 00 02 FB 01
			06 01 00 00 0a 00 01 BB
			15 01 00 00 0A 00 02 FF 10];
		qcom,mdss-dsi-panel-status-command-state = "dsi_lp_mode";
		qcom,mdss-dsi-panel-status-check-mode = "reg_read";
		qcom,mdss-dsi-panel-status-read-length = <0 0 0 0 0 1 0 0 0 0 0 1 0>;
		qcom,mdss-dsi-panel-status-value = <0x00>, <0x00>;
		lcd-kit,power-on-stage = <1 1 1
				2 1 2
				3 1 2
				4 1 2
				11 1 10
				5 2 5
				5 1 5
				5 2 5
				5 1 20
				6 1 0
				7 1 5
				8 1 0>;
		lcd-kit,esd-power-on-stage = <1 1 1
				2 1 2
				3 1 2
				4 1 2
				11 1 10
				5 2 120
				5 1 5
				5 2 5
				5 1 20
				6 1 0
				7 1 5
				8 1 0>;
		lcd-kit,lp-on-stage = <0 0 0>;
		lcd-kit,hs-off-stage = <7 0 0
				8 0 20>;
		lcd-kit,power-off-stage = <5 0 5
				6 0 10
				11 0 2
				4 0 5
				3 0 10
				2 0 0
				1 0 1>;
		lcd-kit,esd-power-off-stage = <5 0 5
				6 0 10
				11 0 2
				4 0 5
				3 0 10
				2 0 120
				1 0 120>;
		lcd-kit,only-power-off-stage = <0 0 0>;
		lcd-kit,pt-support = <0>;
		lcd-kit,panel-on-always-reset = <1>;
		lcd-kit,esd-timing-switch = <1>;
		lcd-kit,lcd-iovcc = <2 6 1900000>;
		lcd-kit,lcd-vsp = <2 11 6000000>;
		lcd-kit,lcd-vsn = <2 12 6000000>;
		lcd-kit,lcd-reset = <2 38 0>;
		lcd-kit,lcd-vci-name = "vdd";
		lcd-kit,lcd-iovcc-name = "vddio";
		lcd-kit,project-id-support = <1>;
		lcd-kit,default-project-id = "W259AX1100";
		lcd-kit,Does-lcd-poweron-tp = <1>;
		lcd-kit,sn-code-support = <1>;
		lcd-kit,oem-info-support = <1>;
		lcd-kit,oem-barcode-2d-support = <1>;
		lcd-kit,oem-barcode-2d-num-offset = <0>;
		lcd-kit,barcode-2d-cmds = <0x39 0x01 0x00 0x00 0x00 0x00 0x04 0xFF 0x98 0x82 0x0B
                0x06 0x01 0x00 0x00 0x00 0x00 0x01 0x10
                0x06 0x01 0x00 0x00 0x00 0x00 0x01 0x11
                0x06 0x01 0x00 0x00 0x00 0x00 0x01 0x12
                0x06 0x01 0x00 0x00 0x00 0x00 0x01 0x13
                0x06 0x01 0x00 0x00 0x00 0x00 0x01 0x14
                0x06 0x01 0x00 0x00 0x00 0x00 0x01 0x15
                0x06 0x01 0x00 0x00 0x00 0x00 0x01 0x16
                0x06 0x01 0x00 0x00 0x00 0x00 0x01 0x17
                0x06 0x01 0x00 0x00 0x00 0x00 0x01 0x18
                0x06 0x01 0x00 0x00 0x00 0x00 0x01 0x19
                0x06 0x01 0x00 0x00 0x00 0x00 0x01 0x1A
                0x06 0x01 0x00 0x00 0x00 0x00 0x01 0x1B
                0x06 0x01 0x00 0x00 0x00 0x00 0x01 0x1C
                0x06 0x01 0x00 0x00 0x00 0x00 0x01 0x1D
                0x06 0x01 0x00 0x00 0x00 0x00 0x01 0x1E
                0x06 0x01 0x00 0x00 0x00 0x00 0x01 0x1F
                0x06 0x01 0x00 0x00 0x00 0x00 0x01 0x20
                0x06 0x01 0x00 0x00 0x00 0x00 0x01 0x21
                0x06 0x01 0x00 0x00 0x00 0x00 0x01 0x22
                0x06 0x01 0x00 0x00 0x00 0x00 0x01 0x23
                0x06 0x01 0x00 0x00 0x00 0x00 0x01 0x24>;
		lcd-kit,barcode-2d-cmds-state = "dsi_lp_mode";
		lcd-kit,panel-getblmaxnit-type = <0>;
		lcd-kit,panel-blmaxnit-min-value = <400>;
		lcd-kit,inversion-support = <0>;
		lcd-kit,panel-gpio-offset = <1100>;
		lcd-kit,finger-unlock-state-support = <0>;
		lcd-kit,esd-reg-te-check = <0>;
		lcd-kit,panel-bl-max-nit = <450>;
		lcd-kit,panel-bl-min = <30>;
		lcd-kit,panel-bl-max = <3932>;
		lcd-kit,panel-bl-def = <128>;
		lcd-kit,check-reg-support = <0>;
		lcd-kit,thp-proximity-support = <0>;
		lcd-kit,proximity-reset-delay-min = <65>;
		lcd-kit,lcd-power-down-vsp = <2 11 5000000>;
		lcd-kit,lcd-power-down-vsn = <2 12 5000000>;
		lcd-kit,backlight-order = <0>;
		lcd-kit,backlight-need-sync = <0>;
		lcd-kit,fps-support = <1>;
		lcd-kit,default-fps = <60>;
		lcd-kit,panel-support-fps-list = <60 120>;
		lcd-kit,fps-60-cmd = "vndservice call display.qservice 25 i32 0 i32 0";
		lcd-kit,fps-90-cmd = "vndservice call display.qservice 25 i32 2 i32 0";
		lcd-kit,fps-120-cmd = "vndservice call display.qservice 25 i32 1 i32 0";
		qcom,mdss-dsi-display-timings {
			timing@0 {
				qcom,mdss-dsi-panel-width = <800>;
				qcom,mdss-dsi-panel-height = <2560>;
				qcom,mdss-dsi-h-front-porch = <36>;
				qcom,mdss-dsi-h-back-porch = <36>;
				qcom,mdss-dsi-h-pulse-width = <20>;
				qcom,mdss-dsi-h-sync-skew = <0>;
				qcom,mdss-dsi-v-front-porch = <2746>;
				qcom,mdss-dsi-v-back-porch = <48>;
				qcom,mdss-dsi-v-pulse-width = <2>;
				qcom,mdss-dsi-panel-framerate = <60>;
				qcom,mdss-dsi-panel-phy-timings= [00 1C 08 07 27 2A 0A
				19 0A 02 04 00 17 0C];
				qcom,display-topology  = <2 0 2>;
				qcom,default-topology-index  = <0>;
				qcom,mdss-dsi-on-command = [
			39 01 00 00 00 00 04 FF 98 82 06
			39 01 00 00 00 00 02 3E E2
			39 01 00 00 00 00 04 FF 98 82 06
			39 01 00 00 00 00 02 56 30
			39 01 00 00 00 00 02 92 22
			39 01 00 00 00 00 04 FF 98 82 05
			39 01 00 00 00 00 02 86 87
			39 01 00 00 00 00 04 FF 98 82 07
			39 01 00 00 00 00 02 84 03
			39 01 00 00 00 00 04 FF 98 82 02
			39 01 00 00 00 00 02 3A 32
			39 01 00 00 00 00 04 FF 98 82 02
			39 01 00 00 00 00 02 3B 44
			39 01 00 00 00 00 04 FF 98 82 02
			39 01 00 00 00 00 02 3C 63
			39 01 00 00 00 00 04 FF 98 82 0B
			39 01 00 00 00 00 02 A7 39
			39 01 00 00 00 00 04 FF 98 82 04
			39 01 00 00 00 00 02 BA 81
			39 01 00 00 00 00 04 FF 98 82 0C
			39 01 00 00 00 00 02 00 16
			39 01 00 00 00 00 02 01 00
			39 01 00 00 00 00 04 FF 98 82 0C
			39 01 00 00 00 00 02 02 16
			39 01 00 00 00 00 02 03 00
			39 01 00 00 00 00 04 FF 98 82 04
			39 01 00 00 00 00 02 BA 01
			39 01 00 00 00 00 04 FF 98 82 0E
			39 01 00 00 00 00 02 02 2A
			39 01 00 00 00 00 04 FF 98 82 0E
			39 01 00 00 00 00 02 08 16
			39 01 00 00 00 00 04 FF 98 82 0E
			39 01 00 00 00 00 02 29 4D
			39 01 00 00 00 00 04 FF 98 82 0E
			39 01 00 00 00 00 02 2A 23
			39 01 00 00 00 00 04 FF 98 82 0E
			39 01 00 00 00 00 02 C0 38
			39 01 00 00 00 00 04 FF 98 82 0E
			39 01 00 00 00 00 02 D0 A8
			39 01 00 00 00 00 04 FF 98 82 0E
			39 01 00 00 00 00 02 CF A8
			39 01 00 00 00 00 04 FF 98 82 0E
			39 01 00 00 00 00 02 CE A8
			39 01 00 00 00 00 04 FF 98 82 0E
			39 01 00 00 00 00 02 38 8F
			39 01 00 00 00 00 04 FF 98 82 1E
			39 01 00 00 00 00 02 61 0B
			39 01 00 00 00 00 04 FF 98 82 02
			39 01 00 00 00 00 02 1B 01
			39 01 00 00 00 00 02 06 5A
			39 01 00 00 00 00 02 07 00
			39 01 00 00 00 00 02 08 32
			39 01 00 00 00 00 02 09 44
			39 01 00 00 00 00 04 FF 98 82 01
			39 01 00 00 00 00 02 E6 24
			39 01 00 00 00 00 04 FF 98 82 12
			39 01 00 00 00 00 02 00 0A
			39 01 00 00 00 00 02 01 00
			39 01 00 00 00 00 02 02 32
			39 01 00 00 00 00 02 03 E1
			39 01 00 00 00 00 04 FF 98 82 06
			39 01 00 00 00 00 02 48 39
			39 01 00 00 00 00 02 D7 11
			39 01 00 00 00 00 04 FF 98 82 00
			05 01 00 00 78 00 01 11
			05 01 00 00 64 00 01 29];
				qcom,mdss-dsi-on-command-state = "dsi_lp_mode";
				qcom,mdss-dsi-off-command = [39 01 00 00 05 00 04 FF 98 82 00
			39 01 00 00 00 00 04 FF 98 82 00
			05 01 00 00 14 00 01 28
			05 01 00 00 78 00 01 10
			39 01 00 00 00 00 04 FF 98 82 06
			39 01 00 00 00 00 02 D0 0A
			39 01 00 00 00 00 02 D1 02
			39 01 00 00 01 00 02 03 F0
			39 01 00 00 00 00 02 D1 00];
				qcom,mdss-dsi-off-command-state = "dsi_lp_mode";
			};
		};
    };
};