/*---------------------------------------------------------------------------
 * This file is autogenerated file using huawei LCD parser. Please do not edit it.
 * Update input XML file to add a new entry or update variable in this file
 * Parser location: vendor/huawei/chipset_common/devkit/lcdkit/tools 
 *---------------------------------------------------------------------------*/


#include "marx_110_505_10p8_qcom.dtsi"
#include "marx_190_505_10p8_qcom.dtsi"
#include "marx_300_505_10p8_qcom.dtsi"
#include "marx_auo_otm1901a_10p8_1080p_video_default.dtsi"