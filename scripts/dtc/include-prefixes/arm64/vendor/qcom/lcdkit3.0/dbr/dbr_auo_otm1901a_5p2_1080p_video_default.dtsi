/* Copyright (c) 2013, The Linux Foundation. All rights reserved.
 *
 * This program is free software; you can redistribute it and/or modify
 * it under the terms of the GNU General Public License version 2 and
 * only version 2 as published by the Free Software Foundation.
 *
 * This program is distributed in the hope that it will be useful,
 * but WITHOUT ANY WARRANTY; without even the implied warranty of
 * MERCHANTABILITY or FITNESS FOR A PARTICULAR PURPOSE.  See the
 * GNU General Public License for more details.
 */

/*-------------------------------------------------------------------------
 * This file is autogenerated file using gcdb parser. Please do not edit it.
 * Update input XML file to add a new entry or update variable in this file
 * VERSION = 1.1
 *-----------------------------------------------------------------------*/
&mdss_mdp {
	dsi_dbr_auo_otm1901a_5p2_1080p_video_default: lcd_kit_dbr_auo_otm1901a_5p2_1080p_video_default {
		compatible = "auo_otm1901a_5p2_1080p_video_default";
		lcd-kit,panel-name = "AUO_OTM1901A 5.2' VIDEO TFT 1600 x 2560 DEFAULT";
		lcd-kit,panel-type = <0x01>;
		lcd-kit,panel-xres = <1080>;
		lcd-kit,panel-yres = <1920>;
		lcd-kit,panel-width = <75>;
		lcd-kit,panel-height = <133>;
		lcd-kit,panel-on-cmds = [29 01 00 00 0a 00 02 00 00
				29 01 00 00 0a 00 04 FF 19 01 01
				29 01 00 00 0a 00 02 00 80
				29 01 00 00 0a 00 03 FF 19 01
				29 01 00 00 0a 00 02 00 88
				29 01 00 00 0a 00 02 f3 00
				29 01 00 00 0a 00 02 00 B0
				29 01 00 00 0a 00 02 CA 01
				29 01 00 00 0a 00 02 00 B1
				29 01 00 00 0a 00 02 CA 01
				29 01 00 00 0a 00 02 00 B3
				29 01 00 00 0a 00 02 CA 40
				29 01 00 00 0a 00 02 00 00
				29 01 00 00 0a 00 04 FF FF FF FF
				15 01 00 00 0a 00 02 35 01
				15 01 00 00 0a 00 02 53 24
				15 01 00 00 0a 00 02 55 00
				15 01 00 00 0a 00 02 5E 28
				05 01 00 00 78 01 02 11 00
				05 01 00 00 64 01 02 29 00];
		lcd-kit,panel-off-cmds = [05 01 00 00 3C 01 02 28 00
			05 01 00 00 78 01 02 10 00];
		lcd-kit,backlight-cmds = [15 01 00 00 00 00 02 51 00];
		lcd-kit,tp-color-cmds = [06 01 00 00 0a 00 01 da];
		lcd-kit,effect-on-cmds = [15 01 00 00 0a 00 02 55 81];
		lcd-kit,check-reg-on-cmds = <0x06 0x01 0x00 0x00 0x0a 0x00 0x01 0x0a>;
		lcd-kit,check-reg-on-value = <0x9c>;
		lcd-kit,check-aod-reg-on-cmds = <0x06 0x01 0x00 0x00 0x0a 0x00 0x01 0x0a>;
		lcd-kit,check-aod-reg-on-value = <0xdc>;
		lcd-kit,check-reg-off-cmds = <0x06 0x01 0x00 0x00 0x0a 0x00 0x01 0x0a>;
		lcd-kit,check-reg-off-value = <0x08>;
		lcd-kit,check-reg-on-cmds-state = "dsi_lp_mode";
		lcd-kit,check-aod-reg-on-cmds-state = "dsi_lp_mode";
		lcd-kit,check-reg-off-cmds-state = "dsi_lp_mode";
		lcd-kit,panel-bl-maxnit-command = [06 01 00 00 0a 00 01 db];
		lcd-kit,panel-bl-maxnit-command-state = "dsi_lp_mode";
		lcd-kit,bl-after-frame = <0>;
		lcd-kit,cmd-async-support = <0>;
		lcd-kit,check-reg-on-support = <0>;
		lcd-kit,check-reg-on-support-dsm-report = <0>;
		lcd-kit,check-aod-reg-on-support = <0>;
		lcd-kit,check-aod-reg-on-support-dsm-report = <0>;
		lcd-kit,check-reg-off-support = <0>;
		lcd-kit,check-reg-off-support-dsm-report = <0>;
		lcd-kit,vtc-line-no-reset = <1>;
		qcom,mdss-dsi-panel-type = "dsi_video_mode";
		qcom,mdss-pan-physical-width-dimension = <69>;
		qcom,mdss-pan-physical-height-dimension = <154>;
		qcom,dsi-ctrl-num = <0>;
		qcom,dsi-phy-num = <0>;
		qcom,panel-supply-entries = <&dsi_panel_pwr_supply>;
		qcom,mdss-dsi-virtual-channel-id = <0>;
		qcom,mdss-dsi-h-sync-pulse = <0>;
		qcom,mdss-dsi-bllp-eof-power-mode;
		qcom,mdss-dsi-bllp-power-mode;
		qcom,mdss-dsi-dma-schedule-line = <1>;
		qcom,mdss-dsi-bpp = <24>;
		qcom,mdss-dsi-color-order = "rgb_swap_rgb";
		qcom,mdss-dsi-underflow-color = <0xff>;
		qcom,mdss-dsi-border-color = <0>;
		qcom,mdss-dsi-traffic-mode = "burst_mode";
		qcom,mdss-dsi-lane-map = "lane_map_0123";
		qcom,mdss-dsi-lane-0-state;
		qcom,mdss-dsi-lane-1-state;
		qcom,mdss-dsi-lane-2-state;
		qcom,mdss-dsi-lane-3-state;
		qcom,mdss-dsi-mdp-trigger = "none";
		qcom,mdss-dsi-dma-trigger = "trigger_sw";
		qcom,mdss-dsi-te-pin-select = <0>;
		qcom,mdss-dsi-t-clk-post = <0x0f>;
		qcom,mdss-dsi-t-clk-pre = <0x37>;
		qcom,mdss-dsi-tx-eot-append;
		qcom,dsi-select-clocks = "mux_byte_clk0", "mux_pixel_clk0", "src_byte_clk0", "src_pixel_clk0", "shadow_byte_clk0", "shadow_pixel_clk0";
		qcom,mdss-dsi-stream = <0>;
		qcom,mdss-dsi-lp11-init;
		lcd-kit,check-thread-support = <0>;
		lcd-kit,check-time-period = <5000>;
		lcd-kit,check-fold-support = <0>;
		lcd-kit,fold-low-power-support = <0>;
		lcd-kit,fold-height = <0>;
		lcd-kit,unfold-height = <0>;
		lcd-kit,power-support = <0>;
		lcd-kit,three-stage-poweron = <0>;
		qcom,apaod-lp2-need-sendcmd;
		lcd-kit,fold-lp-time = <0>;
		lcd-kit,fold-nolp-time = <0>;
		qcom,sublinks-count = <2>;
		qcom,lanes-per-sublink = <2>;
		qcom,mdss-dsi-panel-hdr-color-primaries = <14500 15500 32000 17000 15500 30000 8000 3000>;
		qcom,mdss-dsi-panel-peak-brightness = <4200000>;
		qcom,mdss-dsi-panel-blackness-level = <3230>;
		qcom,dynamic-mode-switch-type = "dynamic-resolution-switch-immediate";
		qcom,mdss-dsi-bl-pmic-control-type = "bl_ctrl_i2c_ic";
		qcom,bl-pmic-pwm-period-usecs = <100>;
		lcd-kit,power-on-stage = <5 2 1
				5 1 5
				5 2 1
				5 1 10
				7 1 2>;
		lcd-kit,lp-on-stage = <8 1 0>;
		lcd-kit,lp-off-stage = <7 0 0>;
		lcd-kit,power-off-stage = <8 0 0
				4 0 1
				3 0 2>;
		lcd-kit,only-power-off-stage = <0 0 0>;
		lcd-kit,pt-support = <1>;
		lcd-kit,panel-on-always-reset = <0>;
		lcd-kit,lcd-vsp = <2 11 5500000>;
		lcd-kit,lcd-vsn = <2 12 5500000>;
		lcd-kit,lcd-reset = <2 38 0>;
		lcd-kit,project-id-support = <1>;
		lcd-kit,default-project-id = "G240A7270";
		lcd-kit,sn-code-support = <0>;
		lcd-kit,panel-getblmaxnit-type = <0>;
		lcd-kit,panel-blmaxnit-min-value = <640>;
		lcd-kit,inversion-support = <0>;
		lcd-kit,panel-gpio-offset = <1100>;
		lcd-kit,finger-unlock-state-support = <0>;
		lcd-kit,esd-reg-te-check = <0>;
		lcd-kit,panel-bl-max-nit = <820>;
		lcd-kit,panel-bl-min = <4>;
		lcd-kit,panel-bl-max = <4095>;
		lcd-kit,panel-bl-def = <128>;
		lcd-kit,check-reg-support = <0>;
		lcd-kit,thp-proximity-support = <0>;
		lcd-kit,proximity-reset-delay-min = <65>;
		lcd-kit,backlight-order = <0>;
		lcd-kit,backlight-need-sync = <0>;
		lcd-kit,fps-60-cmd = "vndservice call display.qservice 25 i32 0 i32 0";
		lcd-kit,fps-90-cmd = "vndservice call display.qservice 25 i32 2 i32 0";
		lcd-kit,fps-120-cmd = "vndservice call display.qservice 25 i32 1 i32 0";
		qcom,mdss-dsi-display-timings {
			timing@0 {
				qcom,mdss-dsi-panel-width = <1080>;
				qcom,mdss-dsi-panel-height = <2376>;
				qcom,mdss-dsi-h-front-porch = <72>;
				qcom,mdss-dsi-h-back-porch = <56>;
				qcom,mdss-dsi-h-pulse-width = <12>;
				qcom,mdss-dsi-h-sync-skew = <0>;
				qcom,mdss-dsi-v-front-porch = <64>;
				qcom,mdss-dsi-v-back-porch = <34>;
				qcom,mdss-dsi-v-pulse-width = <2>;
				qcom,mdss-dsi-panel-framerate = <60>;
				qcom,mdss-dsi-panel-phy-timings= [00 24 0A 0A 26 25 09
				0A 09 02 04 00 1F 0A];
				qcom,display-topology  = <1 0 1>;
				qcom,default-topology-index  = <0>;
				qcom,mdss-dsi-on-command = [15 01 00 00 0a 00 02 FF C0
					15 01 00 00 0a 00 02 FB 01
					15 01 00 00 0a 00 02 C8 07
					15 01 00 00 0a 00 02 C9 07
					15 01 00 00 0a 00 02 CA 07
					15 01 00 00 0a 00 02 CB 07
					15 01 00 00 0a 00 02 FF F0
					15 01 00 00 0a 00 02 FB 01
					15 01 00 00 0a 00 02 8E 21
					15 01 00 00 0a 00 02 FF 10
					15 01 00 00 0a 00 02 FB 01
					15 01 00 00 0a 00 02 B0 00
					39 01 00 00 01 01 11 C1 89 28 00 08 02 00 02 0E 00 BB 00 07 0D B7 0C B7
					15 01 00 00 0a 00 02 FF 25
					15 01 00 00 0a 00 02 FB 01
					15 01 00 00 0a 00 02 18 20
					15 01 00 00 0a 00 02 FF 23
					15 01 00 00 0a 00 02 FB 01
					15 01 00 00 0a 00 02 00 80
					15 01 00 00 0a 00 02 07 20
					15 01 00 00 0a 00 02 08 01
					15 01 00 00 0a 00 02 09 B5
					15 01 00 00 0a 00 02 FF 10
					15 01 00 00 0a 00 02 FB 01
					39 01 00 00 0a 00 03 51 0f ff
					15 01 00 00 0a 00 02 53 24
					39 01 00 00 0a 00 03 61 00 00
					15 01 00 00 0a 00 02 63 24
					15 01 00 00 0a 00 02 35 00
					05 01 00 00 0a 01 01 11
					05 01 00 00 78 01 01 29];
				qcom,mdss-dsi-on-command-state = "dsi_lp_mode";
				qcom,mdss-dsi-off-command = [05 01 00 00 0a 00 01 28
					05 01 00 00 0a 00 01 10];
				qcom,mdss-dsi-off-command-state = "dsi_lp_mode";
			};
		};
    };
};