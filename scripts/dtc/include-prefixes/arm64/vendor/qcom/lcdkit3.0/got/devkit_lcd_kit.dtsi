/*---------------------------------------------------------------------------
 * This file is autogenerated file using huawei LCD parser. Please do not edit it.
 * Update input XML file to add a new entry or update variable in this file
 * Parser location: vendor/huawei/chipset_common/devkit/lcdkit/tools 
 *---------------------------------------------------------------------------*/


#include "got_350_c00_12p6_qcom.dtsi"
#include "got_350_h01_12p6_qcom.dtsi"
#include "got_auo_otm3501a_5p2_1600p_video_default.dtsi"