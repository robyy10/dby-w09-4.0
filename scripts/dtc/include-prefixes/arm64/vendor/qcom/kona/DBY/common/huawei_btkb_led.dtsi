&btkb_led {
	status = "ok";
	btkb_led_notifier = <1>;
	btkb_led_notifier_client = <1>;
	panel = <&dsi_debussy_290_20d_10p9_qcom &dsi_debussy_110_20d_10p9_qcom &dsi_debussy_110_a09_10p9_qcom &dsi_debussy_190_20d_10p9_qcom>;
};
