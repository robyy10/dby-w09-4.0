## drivers/blackbox/platform/Kconfig
```kconfig
# SPDX-License-Identifier: GPL-2.0
config DFX_RAINBOW_TRACE
	depends on BLACKBOX
	default n
		bool "rainbow_trace"
	help
		rainbow trace will record irq and schedule trace log.

config DFX_RAINBOW_HIMNTN
	depends on BLACKBOX
	default n
		bool "rainbow_himntn"
	help
		rainbow himntn control kernel mntn.
```

## drivers/devkit/lcdkit/lcdkit3.0/kernel/qcom/src/Kconfig
```kconfig
#
# lcdkit qcom driver configuration
#
menuconfig LCD_KIT_QCOM
	bool "lcd kit 3.0 qcom driver"
	default n
	help
	   If you say yes here you get support for lcd kit qcom driver.

#
# lcdkit hybrid driver configuration
#
menuconfig LCD_KIT_HYBRID
	bool "lcd kit 3.0 hybrid driver"
	default n
	help
	   If you say yes here you get support for lcd kit hybrid driver.

#
# lcdkit crop driver configuration
#
menuconfig LCD_KIT_CROP
	bool "lcd kit 3.0 crop driver"
	default n
	help
	   If you say yes here you get support for lcd kit crop driver.
```

## drivers/huawei_platform/mntn/Kconfig
```kconfig
config HUAWEI_PLATFORM_MAINTAIN
	bool "Huawei platform maintain module support"
	default n
	help
	  Say yes here to support the huawei platform maintain module

config MNTN_FULLDUMP
	bool "Support Maintainance Fulldump"
	default n
	help
	  This driver supports maintainance fulldump, etc.

config HW_MNTN_FACOTORY
	bool "Huawei Factory Model"
	default n
	help
	  This tran factory to kernel.

source "drivers/huawei_platform/mntn/blackbox/Kconfig"
```

## drivers/huawei_platform/usb/pd/Kconfig
```kconfig
source "drivers/huawei_platform/usb/pd/richtek/Kconfig"
config HUAWEI_PD
        bool "huawei_pd"
        default n

config HUAWEI_PD_THIRDPARTY
        bool "huawei_pd_thirdparty"
        default n
```

## drivers/hwpower/cc_hardware_ic/boost_ic/Kconfig
```kconfig
# SPDX-License-Identifier: GPL-2.0
#
# huawei boost drivers
#

config BOOST_SC8933
	bool "boost sc8933"
	default n
	help
	  Say Y here to enable boost sc8933 driver.
```

## drivers/hwsensors/Kconfig
```kconfig
#
# huawei hall interface
#

source "drivers/hwsensors/hall/Kconfig"

#
# huawei fkey
#

source "drivers/hwsensors/f_key/Kconfig"
```

## drivers/hwsensors/f_key/Kconfig
```kconfig
#
# huawei fkey
#

config HUAWEI_FKEY
	bool "fkey"
	default n
	help
	  Say Y here to enable fkey driver.
```

## drivers/hwusb/hw_dp/Kconfig
```kconfig
config HUAWEI_DP_DSM
	bool "huawei dp dsm driver"
	help
	  Enable this option to enable the dp dsm

config HUAWEI_DP_SOURCE
	bool "huawei dp source switch driver"
	help
	  Enable this option to enable the dp source switch

config HUAWEI_DP_QCOM
	bool "qcom platform for dp driver"
	help
	  Enable this option to enable the qcom platform
```

## drivers/input/btkbled/Kconfig
```kconfig
config INPUT_BTKB_LED
	tristate "btkb_led" if EXPERT
	default n
	help
	  Say Y here if you want bt keyboard led suspend and resume contrl by drm or fb. If unsure, say N.
```

## drivers/power/Kconfig
```kconfig
source "drivers/power/avs/Kconfig"
source "drivers/power/reset/Kconfig"
source "drivers/power/supply/Kconfig"
source "drivers/power/charger/Kconfig"
source "drivers/power/dubai/Kconfig"
source "drivers/power/huawei_adc/Kconfig"
```

## drivers/power/dubai/Kconfig
```kconfig
menu "Huawei Device Usage Big-data Analytics Initiative Support"

config POWER_DUBAI
	bool "Device Usage Big-data Analytics Initiative Support"
	default n
	select HUAWEI_DUBAI
	help
	  This driver provides DUBAI feature

config HUAWEI_DUBAI
	bool "Huawei Device Usage Big-data Analytics Initiative Support"
	default n
	help
	  This driver provides DUBAI feature

config POWER_DUBAI_TASK_CPU_POWER
	bool "DUBAI Task CPU Power"
	default n
	depends on POWER_DUBAI && (CPU_FREQ_POWER_STAT || ARCH_MSM)
	help
	  Get task cpu power

config HUAWEI_DUBAI_TASK_CPU_POWER
	bool "Huawei DUBAI Task CPU Power"
	default n
	depends on HUAWEI_DUBAI && CPU_FREQ_POWER_STAT
	help
	  Get task cpu power

config POWER_DUBAI_RGB_STATS
	bool "DUBAI Rgb Stats"
	default n
	depends on POWER_DUBAI && FB
	help
	  Get Rgb Stats

config HUAWEI_DUBAI_RGB_STATS
	bool "Huawei DUBAI Rgb Stats"
	default n
	depends on HUAWEI_DUBAI && FB
	help
	  Get Rgb Stats

endmenu
```

## drivers/staging/android/Kconfig
```kconfig
menu "Android"

if ANDROID

config ASHMEM
	bool "Enable the Anonymous Shared Memory Subsystem"
	default n
	depends on SHMEM
	help
	  The ashmem subsystem is a new shared memory allocator, similar to
	  POSIX SHM but with different behavior and sporting a simpler
	  file-based API.

	  It is, in theory, a good memory allocator for low-memory devices,
	  because it can discard shared memory units when under memory pressure.

config ANDROID_VSOC
	tristate "Android Virtual SoC support"
	default n
	depends on PCI_MSI
	help
	  This option adds support for the Virtual SoC driver needed to boot
	  a 'cuttlefish' Android image inside QEmu. The driver interacts with
	  a QEmu ivshmem device. If built as a module, it will be called vsoc.

config HUAWEI_RCC
	tristate "RAM Compress and Clean"
	depends on SYSFS && SWAP
	default n
	help
	  Creates background thread for compress and clean used RAM
	  dynamiclly,enabled by write 1 to /sys/kernel/rcc/enable.

config HUAWEI_RCC_DEBUG
	bool "RAM Compress and Clean debug support"
	depends on HUAWEI_RCC
	default n
	help
	  This option adds additional debugging code to the
	  RAM Compress and Clean module.

config HUAWEI_LMK_DBG
        bool "HUAWEI Low Memory Killer debug"
        default n
        ---help---
          print processes info when lmk happen per several seconds

source "drivers/staging/android/ion/Kconfig"

source "drivers/staging/android/hwlogger/Kconfig"

endif # if ANDROID

endmenu
```

## drivers/zerohung/Kconfig
```kconfig
config DFX_ZEROHUNG
	depends on HW_LOGGER
	bool "zero hung driver"
	default n
	---help---
	  This feature support to catch hung log

config DFX_ZEROHUNG_EXT
	depends on HW_LOGGER
	bool "zero hung driver"
	default n
	---help---
	  This feature support to catch hung log

config DFX_ZEROHUNG_SOFTLOCKUP
	depends on HW_LOGGER && LOCKUP_DETECTOR
	bool "softlockup"
	default n
	---help---
		This feature use to detect softlockup

config DFX_ZEROHUNG_SOFTLOCKUP_INJECT
	depends on HW_LOGGER
	bool "softlockup inject"
	default n
	---help---
	  This feature use to cause softlockup
```

## kernel/hwqos/Kconfig
```kconfig
config HW_QOS_THREAD
    bool "iaware 5.0 qos thread"
    default n
    help
      if set, qos thread is propagated by lock&binder, and picked first in lock's waitlist

config HW_ASYNC_BINDER_TRANS
    bool "iaware async binder trans"
    default n
    help
      if set, async binder prio can be trans
```

## mm/alloc_acct/Kconfig
```kconfig
config HW_ALLOC_ACCT
	bool "Enable Alloc account
	default n
	help
	  This macro controls the functions of alloc account.
```
